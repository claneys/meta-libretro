## conf/layer.conf
```bitbake
# We have a conf and classes directory, add to BBPATH
BBPATH .= ":${LAYERDIR}"

# We have recipes-* directories, add to BBFILES
BBFILES += "${LAYERDIR}/recipes-*/*/*.bb \
	${LAYERDIR}/recipes-*/*/*.bbappend"

BBFILE_COLLECTIONS += "meta-libretro"
BBFILE_PATTERN_meta-libretro = "^${LAYERDIR}/"
BBFILE_PRIORITY_meta-libretro = "6"

LAYERVERSION_meta-libretro = "1"
LAYERDEPENDS_meta-libretro = "core openembedded-layer"
```
